## bsp/riscv64-virt/board/ports/OpenAMP/Kconfig
```kconfig
config RT_USING_OPENAMP
    bool "ENABLE OpenAMP"
    default y

config RT_USING_OPENAMP_TEST
    bool "ENABLE OpenAMP test"
    default y
```
